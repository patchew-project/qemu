## Kconfig.host
```kconfig
# These are "proxy" symbols used to pass config-host.mak values
# down to Kconfig.

config KVM
    bool

config IVHSMEM
    bool

config LINUX
    bool

config OPENGL
    bool

config SPICE
    bool

config IVSHMEM
    bool

config TPM
    bool

config VHOST_USER
    bool

config XEN
    bool

config VIRTFS
    bool
```

## accel/Kconfig
```kconfig
config WHPX
    bool

config NVMM
    bool

config HAX
    bool

config HVF
    bool

config TCG
    bool

config KVM
    bool
    imply XEN_EMU if (I386 || X86_64)

config XEN
    bool
    select FSDEV_9P if VIRTFS
```

## backends/Kconfig
```kconfig
source tpm/Kconfig

config IOMMUFD
    bool
    depends on VFIO && LINUX

config SPDM_SOCKET
    bool
    default y
```

## hw/acpi/Kconfig
```kconfig
config ACPI
    bool

config ACPI_X86
    bool
    select ACPI

config ACPI_X86_ICH
    bool
    select ACPI_X86

config ACPI_CPU_HOTPLUG
    bool

config ACPI_MEMORY_HOTPLUG
    bool
    select MEM_DEVICE

config ACPI_NVDIMM
    bool
    default y
    depends on PC || Q35

config ACPI_VMGENID
    bool
    default y
    depends on PC || Q35

config IPMI
    bool
    depends on PC
```

## hw/alpha/Kconfig
```kconfig
config DP264
    bool
    select CY82C693UB
    imply PCI_DEVICES
    imply TEST_DEVICES
    select I82374
    select IDE_CMD646
    select PCI
    select SMC37C669
```

## hw/arc/Kconfig
```kconfig
config ARC_VIRT
    bool
    select SERIAL
    select VIRTIO_MMIO

config ARC
    bool
```

## hw/audio/Kconfig
```kconfig
config SB16
    bool
    default y
    depends on ISA_BUS && AUDIO

config ES1370
    bool
    default y if PCI_DEVICES
    depends on PCI && AUDIO

config AC97
    bool
    default y if PCI_DEVICES
    depends on PCI && AUDIO

config ADLIB
    bool
    default y
    depends on ISA_BUS && AUDIO

config GUS
    bool
    default y
    depends on ISA_BUS && AUDIO

config CS4231A
    bool
    default y
    depends on ISA_BUS && AUDIO

config HDA
    bool
    default y if PCI_DEVICES
    depends on PCI && AUDIO

config PCSPK
    bool
    default y
    depends on I8254

config WM8750
    bool
    depends on I2C && AUDIO

config PL041
    bool
    depends on AUDIO

config CS4231
    bool
    depends on AUDIO

config ASC
    bool
    depends on AUDIO

config VIRTIO_SND
    bool
    default y
    depends on VIRTIO && AUDIO
```

## hw/avr/Kconfig
```kconfig
config AVR_ATMEGA_MCU
    bool
    select AVR_TIMER16
    select AVR_USART
    select AVR_POWER
    select AVR_WDT

config ARDUINO
    select AVR_ATMEGA_MCU
    select UNIMP
```

## hw/char/Kconfig
```kconfig
config ESCC
    bool

config ESCC2
    bool

config ESCC2_ISA
    bool
    depends on ISA_BUS
    select ESCC2

config PARALLEL
    bool
    default y
    depends on ISA_BUS

config PL011
    bool

config SERIAL
    bool

config SERIAL_ISA
    bool
    default y
    depends on ISA_BUS
    select SERIAL

config SERIAL_PCI
    bool
    default y if PCI_DEVICES
    depends on PCI
    select SERIAL

config SERIAL_PCI_MULTI
    bool
    default y if PCI_DEVICES
    depends on PCI
    select SERIAL

config VIRTIO_SERIAL
    bool
    default y
    depends on VIRTIO

config STM32F2XX_USART
    bool

config CMSDK_APB_UART
    bool

config SCLPCONSOLE
    bool

config TERMINAL3270
    bool
```

## hw/cxl/Kconfig
```kconfig
config CXL
    bool
    default y if PCI_EXPRESS

config I2C_MCTP_CXL
    bool
    default y if CXL && I2C_MCTP
```

## hw/fsi/Kconfig
```kconfig
config FSI_CFAM
    bool
    select FSI
    select FSI_LBUS

config FSI
    bool

config FSI
    bool

config FSI_LBUS
    bool
```

## hw/hyperv/Kconfig
```kconfig
config HYPERV
    bool
    depends on KVM

config HYPERV_TESTDEV
    bool
    default y if TEST_DEVICES
    depends on HYPERV

config VMBUS
    bool
    default y
    depends on HYPERV

config HV_BALLOON
    bool
    default y
    depends on HV_BALLOON_POSSIBLE && VMBUS && HAPROT
```

## hw/i2c/Kconfig
```kconfig
config I2C
    bool

config SMBUS
    bool
    select I2C

config SMBUS_EEPROM
    bool
    select SMBUS

config DDC
    bool
    depends on I2C
    select EDID

config VERSATILE_I2C
    bool
    select I2C

config ACPI_SMBUS
    bool
    select SMBUS

config BITBANG_I2C
    bool
    select I2C

config IMX_I2C
    bool
    select I2C

config MPC_I2C
    bool
    select I2C
```

## hw/i386/Kconfig
```kconfig
config SEV
    bool
    default y if PC && KVM

config PC
    bool

config I440FX
    bool

config ISAPC
    bool
    select ISA_BUS

config Q35
    bool

config VTD
    bool

config AMD_IOMMU
    bool

config VMPORT
    bool

config VMMOUSE
    bool
```

## hw/i386/xen/Kconfig
```kconfig
config XEN_FV
    bool
    default y if XEN
    depends on XEN
    select I440FX
    select FSDEV_9P if VIRTFS
```

## hw/intc/Kconfig
```kconfig
config HEATHROW_PIC
    bool

config I8259
    bool
    select ISA_BUS

config PL190
    bool

config IOAPIC
    bool
    select I8259

config ARM_GIC
    bool
    select MSI_NONBROKEN

config OPENPIC
    bool
    select MSI_NONBROKEN
    select OPENPIC_KVM if KVM

config APIC
    bool
    select MSI_NONBROKEN
    select I8259

config ARM_GIC_KVM
    bool
    default y
    depends on ARM_GIC && KVM

config OPENPIC_KVM
    bool

config XICS
    bool
    select XICS_KVM if KVM

config XICS_SPAPR
    bool
    select XICS

config XIVE
    bool
    select XIVE_KVM if KVM

config XIVE_SPAPR
    bool
    select XIVE

config XICS_KVM
    bool

config XIVE_KVM
    bool

config ALLWINNER_A10_PIC
    bool

config S390_FLIC
    bool

config S390_FLIC_KVM
    bool
    default y
    depends on S390_FLIC && KVM

config OMPIC
    bool

config RX_ICU
    bool

config LOONGSON_LIOINTC
    bool

config SIFIVE_CLINT
    bool

config SIFIVE_PLIC
    bool
```

## hw/ipmi/Kconfig
```kconfig
config IPMI
    bool

config IPMI_LOCAL
    bool
    default y
    depends on IPMI

config IPMI_EXTERN
    bool
    default y
    depends on IPMI

config ISA_IPMI_KCS
    bool
    default y if PC
    select IPMI

config ISA_IPMI_BT
    bool
    default y if PC
    select IPMI
```
