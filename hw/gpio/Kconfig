## hw/gpio/Kconfig
```kconfig
config PL061
    bool

config GPIO_KEY
    bool

config GPIO_MPC8XXX
    bool

config GPIO_PWR
    bool

config SIFIVE_GPIO
    bool

config STM32L4X5_GPIO
    bool

config STM32F1XX_GPIO
    bool
    depends on HAVE_RUST
    select X_STM32F1XX_GPIO_RUST

config PCA9552
    bool
    depends on I2C

config PCA9554
    bool
    depends on I2C

config PCF8574
    bool
    depends on I2C

config ZAURUS_SCOOP
    bool

config CADENCE_GPIO
    bool
```

## hw/sd/Kconfig
```kconfig
config PL181
    bool
    select SD

config SSI_SD
    bool
    depends on SSI
    select SD

config SD
    bool

config DW_MCI
    bool
    select REGISTER
    select SD

config SDHCI
    bool
    select SD

config SDHCI_PCI
    bool
    default y if PCI_DEVICES
    depends on PCI
    select SDHCI

config CADENCE_SDHCI
    bool
    select SDHCI

config AXIADO_SDHCI
    bool
    select SDHCI
```

## hw/ssi/Kconfig
```kconfig
config PL022
    bool
    select SSI

config SIFIVE_SPI
    bool
    select SSI

config SSI
    bool

config PHYTIUM_E2000_QSPI
    bool
    select REGISTER
    select SSI

config XILINX_SPI
    bool
    select SSI

config XILINX_SPIPS
    bool
    select SSI

config STM32F2XX_SPI
    bool
    select SSI

config BCM2835_SPI
    bool
    select SSI

config PNV_SPI
    bool
    select SSI

config ALLWINNER_A10_SPI
    bool
    select SSI
```

## rust/hw/gpio/Kconfig
```kconfig
# SPDX-License-Identifier: GPL-2.0-or-later

config X_STM32F1XX_GPIO_RUST
    bool
```

## target/riscv/Kconfig
```kconfig
config RISCV32
    bool
    select ARM_COMPATIBLE_SEMIHOSTING if TCG
    select DEVICE_TREE # needed by boot.c

config RISCV64
    bool
    select ARM_COMPATIBLE_SEMIHOSTING if TCG
    select DEVICE_TREE # needed by boot.c
    # kvm_arch_fixup_msi_route() needs to access PCIDevice
    select PCI if KVM
```
