## hw/vfio/Kconfig
```kconfig
# SPDX-License-Identifier: GPL-2.0-or-later

config VFIO
    bool
    depends on LINUX && KVM_HOST

config VFIO_PCI
    bool
    default y
    select VFIO
    select EDID
    depends on LINUX && PCI && KVM_HOST

config VFIO_CCW
    bool
    default y
    select VFIO
    depends on LINUX && S390_CCW_VIRTIO && KVM_HOST

config VFIO_AP
    bool
    default y
    select VFIO
    depends on LINUX && S390_CCW_VIRTIO && KVM_HOST

config VFIO_IGD
    bool
    default y if PC_PCI
    depends on VFIO_PCI
```

## hw/virtio/Kconfig
```kconfig
config VIRTIO
    bool

config VIRTIO_RNG
    bool
    default y
    depends on VIRTIO

config VIRTIO_PCI
    bool
    default y
    depends on PCI
    depends on VIRTIO

config VIRTIO_MMIO
    bool
    depends on VIRTIO

config VIRTIO_BALLOON
    bool
    default y
    depends on VIRTIO

config VIRTIO_CRYPTO
    bool
    default y
    depends on VIRTIO
```

## hw/vmapple/Kconfig
```kconfig
config VMAPPLE_AES
    bool

config VMAPPLE_BDIF
    bool

config VMAPPLE_CFG
    bool

config VMAPPLE_PVG
    bool

config VMAPPLE_VIRTIO_BLK
    bool

config VMAPPLE
    bool
    depends on ARM && HVF
    default y if ARM && HVF
    imply PCI_DEVICES
    select ARM_GIC
    select PLATFORM_BUS
    select PCI_EXPRESS
    select PCI_EXPRESS_GENERIC_BRIDGE
    select PL011 # UART
    select PL031 # RTC
    select PL061 # GPIO
    select GPIO_PWR
    select PVPANIC_MMIO
    select VMAPPLE_AES
    select VMAPPLE_BDIF
    select VMAPPLE_CFG
    select VMAPPLE_PVG
```

## hw/watchdog/Kconfig
```kconfig
config CMSDK_APB_WATCHDOG
    bool
    select CMSDK_APB_WATCHDOG_C if !HAVE_RUST
    select X_CMSDK_APB_WATCHDOG_RUST if HAVE_RUST

config CMSDK_APB_WATCHDOG_C
    bool
    select PTIMER

config X_CMSDK_APB_WATCHDOG_RUST
    bool
    select PTIMER

config WDT_IB6300ESB
    bool
    default y if PCI_DEVICES
    depends on PCI

config WDT_IB700
    bool
    default y
    depends on ISA_BUS

config WDT_DIAG288
    bool

config WDT_IMX2
    bool

config WDT_SBSA
    bool

config ALLWINNER_WDT
    bool
    select PTIMER
```

## hw/xtensa/Kconfig
```kconfig
config XTENSA_SIM
    bool

config XTENSA_VIRT
    bool
    select XTENSA_SIM
    select PCI_EXPRESS_GENERIC_BRIDGE
    select PCI_DEVICES
    select VIRTIO_PCI
    select VIRTIO_NET

config XTENSA_XTFPGA
    bool
    select OPENCORES_ETH
    select PFLASH_CFI01
    select SERIAL
```

## target/arm/Kconfig
```kconfig
config ARM
    bool
    select ARM_COMPATIBLE_SEMIHOSTING

config AARCH64
    bool
    select ARM

config ARM_V4
    bool
    depends on TCG && ARM

config ARM_V5
    bool
    depends on TCG && ARM

config ARM_V6
    bool
    depends on TCG && ARM

config ARM_V7R
    bool
    depends on TCG && ARM

config ARM_V7M
    bool
    depends on TCG && ARM
    select PTIMER
```

## target/i386/Kconfig
```kconfig
config I386
    bool

config X86_64
    bool

config SEV
    bool
    depends on KVM && I386
```

## target/mips/Kconfig
```kconfig
config MIPS
    bool
    select SEMIHOSTING if TCG

config MIPS64
    bool
    select MIPS
```
