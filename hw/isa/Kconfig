## hw/isa/Kconfig
```kconfig
config ISA_BUS
    bool

config APM
    bool

config I82378
    bool
    select ISA_BUS
    select I8259
    select I8254
    select I82374
    select MC146818RTC

config PC87312
    bool
    select ISA_BUS
    select I8259
    select I8254
    select I8257
    select MC146818RTC
    select SERIAL_ISA
    select PARALLEL
    select FDC
    select IDE_ISA

config PIIX4
    bool
    # For historical reasons, SuperIO devices are created in the board
    # for PIIX4.
    select ISA_BUS

config VT82C686_SUPERIO
    select SERIAL_ISA
    select PARALLEL
    select FDC
    # TODO AC97
    select SMBUS
    select APM
    select ACPI
    select ACPI_SMBUS
    # FIXME APIC/IOAPIC requires X86
    select APIC if PC
    select IOAPIC if PC

config VT82C686
    bool
    select PCI
    select ISA_BUS
    select I8257
    select I8254
    select I8259
    select I8042
    # TODO DS12885 RTC
    select USB_UHCI
    select IDE_PCI
    select IDE_VIA
    select VT82C686_SUPERIO

config SMC37C669
    bool
    select ISA_BUS
    select SERIAL_ISA
    select PARALLEL
    select FDC

config LPC_ICH9
    bool
    # For historical reasons, SuperIO devices are created in the board
    # for ICH9.
    select ISA_BUS
    select ACPI_SMBUS
    select ACPI_ICH9
```

## hw/m68k/Kconfig
```kconfig
config AN5206
    bool
    select COLDFIRE
    select PTIMER

config MCF5208
    bool
    select COLDFIRE
    select PTIMER

config NEXTCUBE
    bool
    select FRAMEBUFFER
    select ESCC

config Q800
    bool
    select MAC_VIA
    select NUBUS
    select MACFB
    select SWIM
    select ESCC
    select ESP
    select DP8393X

config M68K_VIRT
    bool
    select GOLDFISH_PIC
    select GOLDFISH_TTY
    select GOLDFISH_RTC
    select VIRTIO
    select VIRTIO_MMIO
```

## hw/mcb/Kconfig
```kconfig
config MCB
    bool

config MCB_PCI
    bool
    default y if PCI_DEVICES
    depends on PCI
    select MCB
```

## hw/mem/Kconfig
```kconfig
config DIMM
    bool
    select MEM_DEVICE

config MEM_DEVICE
    bool

config MEM_EXPOSE
    bool

config NVDIMM
    bool
    default y
    depends on PC
```

## hw/mips/Kconfig
```kconfig
config MALTA
    bool
    select EMPTY_SLOT
    select I8259
    select ISA_SUPERIO
    select MIPS_CPS
    select PCNET_PCI
    select PFLASH_CFI01
    select PIIX
    select SERIAL
    select SMBUS_EEPROM

config MIPSSIM
    bool
    select SERIAL
    select MIPSNET

config JAZZ
    bool
    select ISA_BUS
    select RC4030
    select I8259
    select I8254
    select I8257
    select PCSPK
    select VGA_MMIO
    select G364FB
    select DP8393X
    select ESP
    select FDC_SYSBUS
    select MC146818RTC
    select PCKBD
    select SERIAL
    select PARALLEL
    select DS1225Y
    select JAZZ_LED
    select VGA_MMIO

config FULOONG
    bool
    select ATI_VGA
    select PCI_BONITO
    select RTL8139_PCI
    select SMBUS_EEPROM
    select VT82C686

config LOONGSON3V
    bool
    imply VIRTIO_VGA
    imply QXL if SPICE
    select SERIAL
    select GOLDFISH_RTC
    select I8259
    select LOONGSON_LIOINTC
    select PCI_DEVICES
    select PCI_EXPRESS_GENERIC_BRIDGE
    select MSI_NONBROKEN
    select FW_CFG_MIPS

config MIPS_CPS
    bool
    select PTIMER
    select MIPS_ITU

config MIPS_BOSTON
    bool
    select FITLOADER
    select MIPS_CPS
    select PCI_EXPRESS_XILINX
    select AHCI_ICH9
    select SERIAL

config FW_CFG_MIPS
    bool
```

## hw/nios2/Kconfig
```kconfig
config NIOS2_10M50
    bool
    default y
    depends on NIOS2
    select SERIAL
    select ALTERA_TIMER
    select NIOS2_VIC

config NIOS2_GENERIC_NOMMU
    bool
    default y
    depends on NIOS2
```

## hw/nvme/Kconfig
```kconfig
config NVME_PCI
    bool
    default y if PCI_DEVICES || PCIE_DEVICES
    depends on PCI

config NVME_NMI_I2C
    bool
    default y if I2C_MCTP
```

## hw/nvram/Kconfig
```kconfig
config DS1225Y
    bool

config AT24C
    bool
    depends on I2C

config MAC_NVRAM
    bool
    select CHRP_NVRAM

# NMC93XX uses the NS uWire interface (similar to SPI but less configurable)
config NMC93XX_EEPROM
    bool

config CHRP_NVRAM
    bool

config XLNX_EFUSE
    bool

config XLNX_EFUSE_VERSAL
    bool
    default y if XLNX_VERSAL
    select XLNX_EFUSE

config XLNX_EFUSE_ZYNQMP
    bool
    default y if XLNX_ZYNQMP
    select XLNX_EFUSE
```

## hw/pci-bridge/Kconfig
```kconfig
config PCIE_PORT
    bool
    default y
    depends on PCI_EXPRESS

config PXB
    bool
    default y if PC

config XIO3130
    bool
    depends on PCI_EXPRESS

config IOH3420
    bool
    depends on PCI_EXPRESS

config I82801B11
    bool

config DEC_PCI
    bool

config SIMBA
    bool
```

## hw/pci-host/Kconfig
```kconfig
config PAM
    bool

config PREP_PCI
    bool

config GRACKLE_PCI
    bool

config UNIN_PCI
    bool

config PPCE500_PCI
    bool

config VERSATILE_PCI
    bool

config PCI_SABRE
    bool

config PCI_PIIX
    bool
    select PCI

config PCI_EXPRESS_Q35
    bool
    select PCI_EXPRESS
    select PCI
    select XIO3130
    select IOH3420
    select I82801B11

config PCI_EXPRESS_GENERIC_BRIDGE
    bool
    select PCI_EXPRESS

config PCI_EXPRESS_XILINX
    bool
    select PCI_EXPRESS

config PCI_EXPRESS_DESIGNWARE
    bool
    select PCI_EXPRESS
```

## hw/pci/Kconfig
```kconfig
config PCI
    bool

config PCI_EXPRESS
    bool
    select PCI

config PCI_DEVICES
    bool

config MSI
    # selected by interrupt controllers that support MSI
    bool
```

## hw/remote/Kconfig
```kconfig
config VFIO_USER_SERVER
    bool
    default n

config MULTIPROCESS
    bool
    depends on PCI && PCI_EXPRESS && KVM
    select REMOTE_PCIHOST
    select VFIO_USER_SERVER
```

## hw/riscv/Kconfig
```kconfig
config HTIF
    bool

config HART
    bool

config SIFIVE
    bool

config SIFIVE_E
    bool

config SIFIVE_U

config SPIKE
    bool

config RISCV_VIRT
    bool
```

## hw/rx/Kconfig
```kconfig
config RX62N_MCU
    bool
    select RX_ICU
    select RENESAS_TMR8
    select RENESAS_TIMER
    select RENESAS_SCI

config RX_GDBSIM
    bool
    select RX62N_MCU
```

## hw/s390x/Kconfig
```kconfig
config S390_CCW_VIRTIO
    bool
    imply VIRTIO_PCI
    imply TERMINAL3270
    imply VFIO_AP
    imply VFIO_CCW
    imply WDT_DIAG288
    select PCI_EXPRESS
    select S390_FLIC
    select SCLPCONSOLE
    select VIRTIO_CCW
    select MSI_NONBROKEN
    imply E1000E_PCI_EXPRESS
    imply IGB_PCI_EXPRESS
    imply USB_XHCI_PCI
```

## hw/scsi/Kconfig
```kconfig
config SCSI
    bool

config LSI_SCSI_PCI
    bool
    default y if PCI_DEVICES
    depends on PCI
    select SCSI

config MPTSAS_SCSI_PCI
    bool
    default y if PCI_DEVICES
    depends on PCI
    select SCSI

config MEGASAS_SCSI_PCI
    bool
    default y if PCI_DEVICES
    depends on PCI
    select SCSI

config VMW_PVSCSI_SCSI_PCI
    bool
    default y if PCI_DEVICES
    depends on PCI
    select SCSI

config ESP
    bool
    select SCSI

config ESP_PCI
    bool
    default y if PCI_DEVICES
    depends on PCI
    select ESP
    select NMC93XX_EEPROM

config SPAPR_VSCSI
    bool
    default y
    depends on PSERIES
    select SCSI

config VIRTIO_SCSI
    bool
    default y
    depends on VIRTIO
    select SCSI

config VHOST_USER_SCSI
    bool
    default y
    # Only PCI devices are provided for now
    depends on VIRTIO_PCI && VHOST_USER && LINUX
```

## hw/sh4/Kconfig
```kconfig
config R2D
    bool
    imply PCI_DEVICES
    imply TEST_DEVICES
    imply RTL8139_PCI
    select I82378 if TEST_DEVICES
    select IDE_MMIO
    select PFLASH_CFI02
    select USB_OHCI_PCI
    select PCI
    select SM501
    select SH4_DEVICES

config SHIX
    bool
    select SH7750
    select SH4_DEVICES

config SH7750
    bool

config SH4_DEVICES
    bool
    select PTIMER
```

## hw/southbridge/Kconfig
```kconfig
config VT82C686
    bool
    select ISA_SUPERIO
    select ACPI_SMBUS
    select SERIAL_ISA
    select FDC
    select USB_UHCI
    select APM
```

## hw/tpm/Kconfig
```kconfig
config TPM_TIS_ISA
    bool
    depends on TPM && ISA_BUS
    select TPM_TIS

config TPM_TIS_SYSBUS
    bool
    depends on TPM
    select TPM_TIS

config TPM_TIS
    bool
    depends on TPM
    select TPMDEV

config TPM_CRB
    bool
    depends on TPM && PC
    select TPMDEV

config TPM_SPAPR
    bool
    default y
    depends on TPM && PSERIES
    select TPMDEV
```

## hw/tricore/Kconfig
```kconfig
config TRICORE_TESTBOARD
    default y
    depends on TRICORE
    bool

config TRIBOARD
    bool
    default y
    depends on TRICORE
    select TC27X_SOC
    select TC39X_SOC

config TC27X_SOC
    bool
    select TRICORE_ASCLIN
    select TRICORE_IRBUS
    select TRICORE_SCU
    select TRICORE_STM

config TC39X_SOC
    bool
    select TRICORE_ASCLIN
    select TRICORE_IRBUS
    select TRICORE_SCU
    select TRICORE_STM

config TRICORE_SCU
    bool
```

## hw/uefi/Kconfig
```kconfig
config UEFI_VARS
	bool
        default y if X86_64 || AARCH64

config UEFI_VARS_ISA
	bool
        default y
        depends on UEFI_VARS
        depends on ISA_BUS
```
